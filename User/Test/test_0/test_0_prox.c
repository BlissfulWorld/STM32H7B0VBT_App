#include "stdio.h"
#include "string.h"
#include "config.h"
#include "i2c.h"
#include "cmsis_os.h"
#include "test.h"

#define PROX_I2C_ID 0xb0

typedef struct
{
	uint8_t data1[1];
	uint8_t data2[7];
	uint8_t data3[7];
	uint8_t data4[7];
	uint8_t data5[7];
	uint8_t data6[2];
	uint8_t data7[2];
}prox_data_st;

static uint8_t prox_rdy;
static prox_data_st prox_data;
static const uint8_t prox_init_data[];

static const test_0_interface_st* intf;

static uint8_t i2c_write_nd(uint8_t slaveId, uint8_t* pdata, uint32_t size)
{
	return intf->prox_i2c_write_read(pdata, size, 0, 0, size);
}

static uint8_t i2c_read(unsigned char slaveId, unsigned char addr, unsigned char* data, unsigned int size)
{
	return intf->prox_i2c_write_read(&addr, 1, data, size, size);
}

void test_0_prox_set_intf(const test_0_interface_st* i)
{
	intf = i;
}

/**
	*	@描述 Prox Sensor初始化
	*	@参数	空
	* @返回	空
	*/
void test_0_prox_init(void)
{
	prox_rdy = 0;

	memset(&prox_data, 0, sizeof(prox_data));

	GPIO_InitTypeDef gpio_init;

	gpio_init.Alternate = 0;
	gpio_init.Pull = GPIO_PULLUP;
	gpio_init.Speed = GPIO_SPEED_LOW;
	gpio_init.Mode = GPIO_MODE_INPUT;
	gpio_init.Pin = test_pin[intf->prox_inti_pin].pin;
	HAL_GPIO_Init(test_pin[intf->prox_inti_pin].gpio, &gpio_init);
}

/**
	*	@描述 检测Prox Sensor
	*	@参数	空
	* @返回	0:检测到Prox Sensor	!0:未检测到Prox Sensor
	*/
uint8_t test_0_prox_detect(void)
{
	uint8_t ReadVal;

	return i2c_read(PROX_I2C_ID, 0x00, &ReadVal, 1);
}

/**
	* @描述	距离传感器配置
	*/
uint8_t test_0_prox_config(void)
{
	uint8_t ret, ReadData[15], nData;
	uint8_t ReadWrite;
	uint16_t i, z;

	for(i = 0, z = 0;prox_init_data[i] != 0xff;z++)
	{
		/*-- 获取数据长度， --*/
		nData = prox_init_data[i] & 0x0f;

		/*-- 数据操作方式 --*/
		ReadWrite = prox_init_data[i] & 0xf0;

		switch(ReadWrite)
		{
			case 0x10:
				/*-- 写数据，数据长度加上地址字节 --*/
				ret = i2c_write_nd(PROX_I2C_ID, (uint8_t*)&prox_init_data[i + 1], nData + 1);
				if(ret != 0)
					return (z);

				i += (nData + 2);
				break;
			case 0x20:
				/*-- 读数据 --*/
				ret = i2c_read(PROX_I2C_ID, prox_init_data[i + 1], ReadData, nData);
				if(ret != 0)
					return (0x80 | z);

				i += 2;
				break;
			default:
				return (z);
		}
		osDelay(1);
	}

	prox_rdy = 1;

	return 0;
}

/**
	*	@描述	接收距离传感器数据
	*	@参数	距离传感器数据数据类型指针
	*	@返回	!0:有错误	0:读取成功
	*/
static uint8_t prox_receive_data(prox_data_st* Data)
{
	uint8_t ret;
	uint32_t t;

	uint8_t reg6d[3] = { 0x6D,0x00,0x0D };
	ret = i2c_write_nd(PROX_I2C_ID, reg6d, 3);
	if(ret != 0) return 1;
	osDelay(1);

	uint8_t reg70[3] = { 0x70,0x12,0x16 };
	ret = i2c_write_nd(PROX_I2C_ID, reg70, 3);
	if(ret != 0) return 1;

	t = HAL_GetTick();

	while((HAL_GPIO_ReadPin(test_pin[intf->prox_inti_pin].gpio, test_pin[intf->prox_inti_pin].pin) != GPIO_PIN_RESET) && (HAL_GetTick() - t <= 10));
	if(HAL_GetTick() - t > 10)
		return 1;
	osDelay(5);

	ret = i2c_read(PROX_I2C_ID, 0x94, Data->data1, 1);
	if(ret != 0) return 2;

	osDelay(1);

	ret = i2c_read(PROX_I2C_ID, 0x76, Data->data2, 7);
	if(ret != 0) return 3;

	osDelay(1);

	ret = i2c_read(PROX_I2C_ID, 0x7d, Data->data3, 7);
	if(ret != 0) return 4;

	osDelay(1);

	ret = i2c_read(PROX_I2C_ID, 0x84, Data->data4, 7);
	if(ret != 0) return 5;

	osDelay(1);

	ret = i2c_read(PROX_I2C_ID, 0x8b, Data->data5, 7);
	if(ret != 0) return 6;

	osDelay(1);

	ret = i2c_read(PROX_I2C_ID, 0x92, Data->data6, 2);
	if(ret != 0) return 7;

	osDelay(1);

	ret = i2c_read(PROX_I2C_ID, 0xa6, Data->data7, 2);
	if(ret != 0) return 8;

	return 0;
}

/**
	*	@描述	判断Prox Sensor是否就绪
	* @返回	NO_RDY:未就绪	AL_RDY:已就绪 RDY_ING:就绪中
	*/
uint8_t test_0_prox_is_rdy(void)
{
	return prox_rdy;
}

/**
	*	@描述 更新PROX数据
	*/
void test_0_prox_update_data(void)
{
	if(prox_rdy != 0)
	{
		if(prox_receive_data(&prox_data) != 0)
		{
			prox_data.data2[1] = 0;
			prox_data.data2[2] = 0;
			prox_rdy = 0;
		}
	}
	else
	{
		if((test_0_prox_detect() == 0) && (test_0_prox_config() == 0))
		{

		}
	}
}

/**
	*	@描述 获取PROX百分比
	*/
uint16_t test_0_prox_get_percentage(void)
{
	uint8_t percentage;
	uint16_t val = (prox_data.data2[1] << 8) | (prox_data.data2[2]);
	percentage = (val > 0xc0) ? ((val - 0xc0) >> 1) : 0;
	if(percentage > 100) percentage = 100;
	percentage = 100 - percentage;
	return percentage;
}

/**
	* 高4位表示读写，2读 1写
	* 低4位表示读写数据长度，最高15个数据
	* 数据读写地址8位
	* 0xff表示结束
	*/
static const uint8_t prox_init_data[] = {
0x21,0x00,
0x21,0x01,
0x11,0xFE,0x01,
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0x11,0x66,0x20,
0xff
};
